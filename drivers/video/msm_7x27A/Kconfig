## drivers/video/msm_7x27A/Kconfig
```kconfig
if FB_MSM

config FB_MSM_MIPI_DSI_NOVATEK
        bool
        select FB_MSM_MIPI_DSI
        default n

config FB_MSM_MIPI_DSI_ORISE
        bool
        select FB_MSM_MIPI_DSI
        default n

config FB_MSM_MIPI_DSI_SAMSUNG
        bool
        select FB_MSM_MIPI_DSI
        default n

config FB_MSM_MIPI_NOVATEK_CMD_HVGA_PT
	bool
	select FB_MSM_MIPI_DSI_NOVATEK
	default n

config FB_MSM_MIPI_ORISE_CMD_HVGA_PT
	bool
	select FB_MSM_MIPI_DSI_ORISE
	default n

config FB_MSM_MIPI_NOVATEK_VIDEO_HVGA_PT
	bool
	select FB_MSM_MIPI_DSI_NOVATEK
	default n

config FB_MSM_MIPI_SAMSUNG_CMD_HVGA_PT
	bool
	select FB_MSM_MIPI_DSI_SAMSUNG
	default n

config FB_MSM_MIPI_NOVATEK_CMD_HVGA_PT_PANEL
	bool "MIPI NOVATEK CMD HVGA PT Panel"
	select FB_MSM_MIPI_NOVATEK_CMD_HVGA_PT

config FB_MSM_MIPI_NOVATEK_VIDEO_HVGA_PT_PANEL
	bool "MIPI NOVATEK VIDEO HVGA PT Panel"
	select FB_MSM_MIPI_NOVATEK_VIDEO_HVGA_PT

config FB_MSM_MIPI_SAMSUNG_CMD_HVGA_PT_PANEL
	bool "MIPI SAMSUNG CMD HVGA PT Panel"
	select FB_MSM_MIPI_SAMSUNG_CMD_HVGA_PT

endif
```
